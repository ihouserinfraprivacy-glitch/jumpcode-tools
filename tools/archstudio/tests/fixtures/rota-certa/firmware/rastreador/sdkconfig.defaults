## tools/archstudio/tests/fixtures/rota-certa/firmware/rastreador/sdkconfig.defaults
```kconfig
CONFIG_IDF_TARGET="esp32s3"
CONFIG_FREERTOS_HZ=1000
CONFIG_ESP_TASK_WDT_TIMEOUT_S=10
CONFIG_MQTT_PROTOCOL_311=y
```
